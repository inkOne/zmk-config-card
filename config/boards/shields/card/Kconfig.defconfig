## config/boards/shields/card/Kconfig.defconfig
```kconfig
# Copyright (c) 2020 The ZMK Contributors
# SPDX-License-Identifier: MIT

CONFIG_CLOCK_CONTROL_NRF_K32SRC_RC=y
CONFIG_BT_CTLR_TX_PWR_PLUS_8=y


config ZMK_BLE
	default y

config ZMK_USB
	default y

if SHIELD_CARD_DONGLE

config ZMK_KEYBOARD_NAME
	default "The Card Dongle"

endif

if SHIELD_CARD_LEFT || SHIELD_CARD_RIGHT

config ZMK_SPLIT
	default y

endif



if SHIELD_CARD_DONGLE 

config ZMK_SPLIT
	default y

config ZMK_SPLIT_BLE_ROLE_CENTRAL
	default y

endif
```
